## main/Kconfig.projbuild
```kconfig
menu "Temperador Configuration"
    menu "WiFi Configuration"
        config WIFI_NETWORK_SSID
            string "WiFi network SSID"
            default "ssid"
            help
                Name of WiFi network that ESP32 will connect to.
        config WIFI_NETWORK_PASSWORD
            string "WiFi network password"
            default "password"
            help
                Password of WiFi network that ESP32 will connect to.
    endmenu
    menu "Pins configuration"
        config I2C_EXTERNAL_PORT_SCL_PIN
            int "Pin that SCL wire of external sensors I2C bus is attached to"
            default 26
            help
                Number of pin that SCL wire of external sensors I2C bus is attached to
        config I2C_EXTERNAL_PORT_SDA_PIN
            int "Pin that SDA wire of external sensors I2C bus is attached to"
            default 25
            help
                Number of pin that SDA wire of external sensors I2C bus is attached to
        config I2C_INTERNAL_PORT_SCL_PIN
            int "Pin that SCL wire of internal sensors I2C bus is attached to"
            default 33
            help
                Number of pin that SCL wire of internal sensors I2C bus is attached to
        config I2C_INTERNAL_PORT_SDA_PIN
            int "Pin that SDA wire of internal sensors I2C bus is attached to"
            default 32
            help
                Number of pin that SDA wire of internal sensors I2C bus is attached to
        config STATUS_LED_GREEN_CHANNEL_PIN
            int "Pin that status LED green channel is attached to"
            default 12
            help
                Number of pin that status LED green channel is attached to
        config STATUS_LED_BLUE_CHANNEL_PIN
            int "Pin that status LED blue channel is attached to"
            default 27
            help
                Number of pin that status LED blue channel is attached to
    endmenu
endmenu
```
